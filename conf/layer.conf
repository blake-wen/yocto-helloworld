## conf/layer.conf
```bitbake
# We have a conf and classes directory, add to BBPATH
BBPATH .= ":${LAYERDIR}"

# We have recipes-* directories, add to BBFILES
BBFILES += "${LAYERDIR}/recipes-*/*/*.bb \
            ${LAYERDIR}/recipes-*/*/*.bbappend"

BBFILE_COLLECTIONS += "meta-oem-blakecor"
BBFILE_PATTERN_meta-oem-blakecor = "^${LAYERDIR}/"
BBFILE_PRIORITY_meta-oem-blakecor = "6"

LAYERDEPENDS_meta-oem-blakecor = "core"
LAYERSERIES_COMPAT_meta-oem-blakecor = "dunfell"
```
